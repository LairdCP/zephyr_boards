## bl5340_dvk/bl5340pa_dvk_cpunet_defconfig
```kconfig
# SPDX-License-Identifier: Apache-2.0

CONFIG_SOC_SERIES_NRF53X=y
CONFIG_SOC_NRF5340_CPUNET_QKAA=y
CONFIG_BOARD_BL5340PA_DVK_CPUNET=y

# Enable MPU
CONFIG_ARM_MPU=y

# Enable hardware stack protection
CONFIG_HW_STACK_PROTECTION=y

# enable GPIO
CONFIG_GPIO=y

# Disable logging as there is no UART to output over
CONFIG_LOG=n
```

## bl654_usb/bl654_usb_defconfig
```kconfig
# SPDX-License-Identifier: Apache-2.0

CONFIG_SOC_SERIES_NRF52X=y
CONFIG_SOC_NRF52840_QIAA=y
CONFIG_BOARD_BL654_USB=y

# Enable MPU
CONFIG_ARM_MPU=y

# enable GPIO
CONFIG_GPIO=y

# enable USB
CONFIG_USB=y
CONFIG_USB_CDC_ACM=y

# additional board options
CONFIG_GPIO_AS_PINRESET=y
```

## bt520/Kconfig.board
```kconfig
# BT520 board configuration

# Copyright (c) 2020-2022 Laird Connectivity
# SPDX-License-Identifier: Apache-2.0

config BOARD_BT520
	bool "BT520"
	depends on SOC_NRF52840_QIAA
```

## bt520/Kconfig.defconfig
```kconfig
# BT520 Sensor configuration

# Copyright (c) 2020-2022 Laird Connectivity
# SPDX-License-Identifier: Apache-2.0

if BOARD_BT520

config BOARD
	default "bt520"

config IEEE802154_NRF5
	default y
	depends on IEEE802154

config BT_CTLR
	default BT

endif # BOARD_BT520
```

## bt6/Kconfig.board
```kconfig
# BT6 board configuration

# Copyright (c) 2020 Laird Connectivity
# SPDX-License-Identifier: Apache-2.0

config BOARD_BT6
	bool "BT6"
	depends on SOC_NRF52840_QIAA
```

## bt6/Kconfig.defconfig
```kconfig
# BT6 Sensor configuration

# Copyright (c) 2020 Laird Connectivity
# SPDX-License-Identifier: Apache-2.0

if BOARD_BT6

config BOARD
	default "bt6"
if USB

config USB_NRFX
	default y

config USB_DEVICE_STACK
	default y

endif # USB

config IEEE802154_NRF5
	default y
	depends on IEEE802154
	
config BT_CTLR
	default BT
		
endif # BOARD_BT6
```

## bt710/Kconfig.board
```kconfig
# BT710 DVK board configuration

# Copyright (c) 2020 Laird Connectivity
# SPDX-License-Identifier: Apache-2.0

config BOARD_BT710
	bool "BT710"
	depends on SOC_NRF52833_QIAA
```

## bt710/Kconfig.defconfig
```kconfig
# BT710 Sensor configuration

# Copyright (c) 2020 Laird Connectivity
# SPDX-License-Identifier: Apache-2.0

if BOARD_BT710

config BOARD
	default "bt710"

config IEEE802154_NRF5
	default y
	depends on IEEE802154

config BT_CTLR
	default BT

endif # BOARD_BT710
```

## bt710/bt710_defconfig
```kconfig
# SPDX-License-Identifier: Apache-2.0

CONFIG_SOC_SERIES_NRF52X=y
CONFIG_SOC_NRF52833_QIAA=y
CONFIG_BOARD_BT710=y

# Enable MPU
CONFIG_ARM_MPU=y

# Enable RTT
CONFIG_USE_SEGGER_RTT=y

# enable GPIO
CONFIG_GPIO=y

# enable UART
CONFIG_SERIAL=y

#enable PWM 
CONFIG_PWM=y

# enable accelerometer & pressure sensor
CONFIG_I2C=y
CONFIG_SENSOR=y
CONFIG_LIS2DH=y
CONFIG_LIS2DH_TRIGGER_GLOBAL_THREAD=y
CONFIG_LIS2DH_OPER_MODE_LOW_POWER=y
CONFIG_BME280=y

# enable flash
CONFIG_SPI=y
CONFIG_FLASH=y
CONFIG_SPI_NOR=y

# enable console
CONFIG_CONSOLE=y
CONFIG_UART_CONSOLE=y

# additional board options
CONFIG_GPIO_AS_PINRESET=y

# 32kHz clock source
CONFIG_CLOCK_CONTROL_NRF_K32SRC_RC=y
CONFIG_CLOCK_CONTROL_NRF_K32SRC_500PPM=y
```

## mg100/Kconfig
```kconfig
# Kconfig - MG100(TM) board configuration
#
# Copyright (c) 2020 Laird Connectivity
#
# SPDX-License-Identifier: Apache-2.0

if BOARD_MG100

config BOARD_ENABLE_DCDC
        bool "Enable DCDC mode"
        select SOC_DCDC_NRF52X
        default y

endif # BOARD_MG100
```

## mg100/Kconfig.board
```kconfig
# Kconfig - MG100(TM) board configuration
#
# Copyright (c) 2020 Laird Connectivity
#
# SPDX-License-Identifier: Apache-2.0

config  BOARD_MG100
	bool "MG100"
	depends on SOC_NRF52840_QIAA
```

## mg100/Kconfig.defconfig
```kconfig
# MG100(TM) board configuration

# Copyright (c) 2020 Laird Connectivity
# SPDX-License-Identifier: Apache-2.0

if BOARD_MG100

config BOARD
	default "MG100"

config MODEM_HL7800
	default NETWORKING

if USB

config USB_NRFX
	default y

config USB_DEVICE_STACK
	default y

endif # USB

config IEEE802154_NRF5
	default y
	depends on IEEE802154

config BT_CTLR
	default BT

endif # BOARD_MG100
```

## mg100/mg100_defconfig
```kconfig
# Copyright (c) 2020-2021 Laird Connectivity

# SPDX-License-Identifier: Apache-2.0

CONFIG_SOC_SERIES_NRF52X=y
CONFIG_SOC_NRF52840_QIAA=y
CONFIG_BOARD_MG100=y

# Enable MPU
CONFIG_ARM_MPU=y

# Enable RTT
CONFIG_USE_SEGGER_RTT=y

# Enable GPIO
CONFIG_GPIO=y

# Enable uart driver
CONFIG_SERIAL=y

# Enable console
CONFIG_CONSOLE=y
CONFIG_UART_CONSOLE=y

# Additional board options
CONFIG_GPIO_AS_PINRESET=y

# SPI
CONFIG_SPI=y

CONFIG_I2C=y
CONFIG_SENSOR=y

CONFIG_LIS2DH=y
CONFIG_LIS2DH_TRIGGER_OWN_THREAD=y
CONFIG_LIS2DH_ACCEL_RANGE_RUNTIME=y
CONFIG_LIS2DH_ODR_RUNTIME=y
CONFIG_LIS2DH_ANYM_ON_INT1=y
CONFIG_LIS2DH_MEASURE_TEMPERATURE=y

# 32KHz clock source
CONFIG_CLOCK_CONTROL_NRF_K32SRC_XTAL=y
CONFIG_CLOCK_CONTROL_NRF_K32SRC_150PPM=y
```

## pinnacle_100_dvk/pinnacle_100_dvk_defconfig
```kconfig
# Copyright (c) 2020 Laird Connectivity

# SPDX-License-Identifier: Apache-2.0

CONFIG_SOC_SERIES_NRF52X=y
CONFIG_SOC_NRF52840_QIAA=y
CONFIG_BOARD_PINNACLE_100_DVK=y

# Enable MPU
CONFIG_ARM_MPU=y

# Enable RTT
CONFIG_USE_SEGGER_RTT=y

# enable GPIO
CONFIG_GPIO=y

# enable uart driver
CONFIG_SERIAL=y

# enable console
CONFIG_CONSOLE=y
CONFIG_UART_CONSOLE=y

# additional board options
CONFIG_GPIO_AS_PINRESET=y

# Modem driver
CONFIG_MODEM=y
CONFIG_MODEM_RECEIVER=y
CONFIG_MODEM_HL7800=y

# Networking
CONFIG_NETWORKING=y
CONFIG_NET_IPV4=y
CONFIG_NET_CONFIG_NEED_IPV4=y
CONFIG_NET_UDP=y
# disable IPv6 because it is not yet supported for the HL7800 driver
CONFIG_NET_IPV6=n
CONFIG_NET_CONFIG_NEED_IPV6=n
```

## summit_som8mplus_dvk/Kconfig
```kconfig
# Summit SOM 8M Plus DVK board configuration
#
# Copyright (c) 2022 Laird Connectivity
# SPDX-License-Identifier: Apache-2.0

if BOARD_SUMMIT_SOM8MPLUS_DVK

if PWM

choice
    prompt "PWM Backlight Pin Selection"
    default PWM_BACKLIGHT_PIN_IO11

config PWM_BACKLIGHT_PIN_IO9
    bool "PWM Backlight on IO9"

config PWM_BACKLIGHT_PIN_IO11
    bool "PWM Backlight on IO11"

endchoice

endif # PWM

endif # BOARD_SUMMIT_SOM8MPLUS_DVK
```

## summit_som8mplus_dvk/Kconfig.board
```kconfig
# Summit SOM 8M Plus DVK board configuration
#
# Copyright (c) 2022, Laird Connectivity
# SPDX-License-Identifier: Apache-2.0

config BOARD_SUMMIT_SOM8MPLUS_DVK
	bool "Laird Connectivity Summit SOM 8M Plus DVK"
	depends on SOC_SERIES_SUMMIT_SOM8M
	select SOC_PART_NUMBER_MIMX8ML8DVNLZ
```

## summit_som8mplus_dvk/Kconfig.defconfig
```kconfig
# Summit SOM 8M Plus DVK board configuration

# Copyright (c) 2022, Laird Connectivity
# SPDX-License-Identifier: Apache-2.0

if BOARD_SUMMIT_SOM8MPLUS_DVK

config BOARD
	default "summit_som8mplus_dvk"

if !XIP
config FLASH_SIZE
	default 0
config FLASH_BASE_ADDRESS
	default 0
endif

config FLASH_MCUX_FLEXSPI_NOR
	default y if FLASH

endif # BOARD_SUMMIT_SOM8MPLUS_DVK
```

## summit_som8mplus_dvk/summit_som8mplus_dvk_itcm_defconfig
```kconfig
# Copyright (c) 2022, Laird Connectivity

# SPDX-License-Identifier: Apache-2.0

CONFIG_SOC_SERIES_SUMMIT_SOM8M=y
CONFIG_SOC_SUMMIT_SOM8MPLUS=y
CONFIG_BOARD_SUMMIT_SOM8MPLUS_DVK=y
CONFIG_CLOCK_CONTROL=y
CONFIG_UART_CONSOLE=y
CONFIG_SERIAL=y
CONFIG_UART_INTERRUPT_DRIVEN=y
CONFIG_CONSOLE=y
CONFIG_XIP=y
CONFIG_CODE_ITCM=y
```

## vet_AEQQ/Kconfig.board
```kconfig
# STM32L476RG RET/VET Laird Connectivity board configuration

# Copyright (c) 2020 Laird Connectivity

config BOARD_VET_AEQQ
	bool "VET AEQQ Development Board"
	depends on SOC_STM32L476XX
```

## vet_AEQQ/Kconfig.defconfig
```kconfig
# STM32L476RG RET board configuration

# Copyright (c) 2020 Laird Connectivity

if BOARD_VET_AEQQ

config BOARD
	default "vet_AEQQ"

if UART_CONSOLE

config UART_2
	default y

endif # UART_CONSOLE

if SPI

config SPI_1
	default y

config SPI_STM32_INTERRUPT
	default y

endif # SPI

if I2C

config I2C_1
	default y

endif # SPI

if PWM

config PWM_STM32_2
	default y

endif # PWM

endif # BOARD_VET_AEQQ
```
